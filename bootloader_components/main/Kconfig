## bootloader_components/main/Kconfig
```kconfig
menu "2nd stage bootloader/ota minimum signatures"
    config SECURE_BOOT_V2_MIN_SIGNATURES
        int "bootloader 2nd stage and ota verifies minimum signatures"
        range 1 3
        default 2 if BOARD_TYPE_JADE_V2_ANY
        default 1
        help
            Number of signatures required for app-images from 2nd stage and ota
endmenu
```
