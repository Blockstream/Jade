const uint8_t _binary_statusbar_large_bin_gz_start[1297] = { 0x78, 0xda, 0xec, 0x97, 0x1, 0x64, 0x1c, 0x41, 0x14,
    0x40, 0xf, 0x8b, 0xc5, 0x61, 0x10, 0x0, 0x58, 0xa0, 0x14, 0x6c, 0x3, 0x4, 0xb0, 0xa, 0x80, 0x5a, 0x40, 0x1, 0xe,
    0x90, 0x6, 0xe7, 0x84, 0x46, 0x2c, 0xac, 0x33, 0x64, 0x9d, 0x43, 0x4, 0x70, 0xa, 0x4, 0x90, 0x2, 0x0, 0x3, 0x0,
    0x10, 0x0, 0x14, 0x7, 0x0, 0xc5, 0xe2, 0x30, 0xe5, 0x30, 0xf5, 0x8c, 0x6f, 0x32, 0x2c, 0x3b, 0x5d, 0x51, 0x71, 0xf2,
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    0xf7, 0xdf, 0x1f, 0x5f, 0xe9, 0x38, 0xe5 };
const uint8_t* _binary_statusbar_large_bin_gz_end = _binary_statusbar_large_bin_gz_start + 1297;
